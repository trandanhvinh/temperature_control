## main/Kconfig.projbuild
```kconfig
menu "Temp Control System Configuration"

    config BROKER_URL
        string "MQTT Broker URL"
        default "mqtt://100.64.0.1:1883"
        help
            URL of the MQTT broker to connect to (e.g., Tailscale IP or local LAN IP).

    config MQTT_TOPIC_PUB
        string "MQTT Publish Topic (Telemetry)"
        default "hethong/temp_control"
        help
            MQTT topic where ESP32-S3 publishes temperature, setpoint, PWM, and mode JSON data.

    config MQTT_TOPIC_SUB
        string "MQTT Subscribe Topic (Setpoint)"
        default "hethong/set_from_web"
        help
            MQTT topic where ESP32-S3 listens for setpoint updates from Node-RED / Web Dashboard.

endmenu
```

## sdkconfig.defaults
```kconfig
# Target Configuration
CONFIG_IDF_TARGET="esp32s3"

# Flash Configuration
CONFIG_ESPTOOLPY_FLASHSIZE_2MB=y
CONFIG_ESPTOOLPY_FLASHFREQ_80M=y

# Example Connection Configuration (Override in local menuconfig)
CONFIG_EXAMPLE_CONNECT_WIFI=y
CONFIG_EXAMPLE_WIFI_SSID="myssid"
CONFIG_EXAMPLE_WIFI_PASSWORD="mypassword"

# Project MQTT & Control Configuration
CONFIG_BROKER_URL="mqtt://100.64.0.1:1883"
CONFIG_MQTT_TOPIC_PUB="hethong/temp_control"
CONFIG_MQTT_TOPIC_SUB="hethong/set_from_web"
```
